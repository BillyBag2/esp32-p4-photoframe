## main/Kconfig.projbuild
```kconfig
config PHOTOFRAME_BLE_PROVISIONING
    bool
    default y
    select ESP_PROTOCOMM_SUPPORT_SECURITY_VERSION_1
    help
        Enable authenticated Bluetooth LE Wi-Fi provisioning.
```

## sdkconfig.defaults
```kconfig
# Common application defaults
CONFIG_COMPILER_CXX_EXCEPTIONS=y
CONFIG_FATFS_LFN_HEAP=y
CONFIG_LV_COLOR_DEPTH_16=y
CONFIG_LV_USE_LOG=y
CONFIG_LV_USE_FS_STDIO=y
CONFIG_LV_FS_STDIO_LETTER=83
CONFIG_JPEG_ENABLE_DEBUG_LOG=n
CONFIG_ESP_PROTOCOMM_SUPPORT_SECURITY_VERSION_1=y
```
